## conf/layer.conf
```bitbake
# We have a conf and classes directory, append to BBPATH
BBPATH .= ":${LAYERDIR}"

# We have a recipes directory containing .bb and .bbappend files, add to BBFILES
BBFILES := "${BBFILES} ${LAYERDIR}/recipes*/*/*.bb \ 
            ${LAYERDIR}/recipes*/*/*.bbappend"

BBFILE_COLLECTIONS += "azbox"
BBFILE_PATTERN_azbox := "^${LAYERDIR}/"
BBFILE_PRIORITY_azbox = "6"
```
